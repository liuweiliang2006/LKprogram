/******************************************************************************
* 文件名         : drv_sound.c
* 工程名         : *
* 作者           : pengwei
* 版本           : *
* 日期           : 2018.07
* 描述           : 驱动程序，语音接口驱动
*
*******************************************************************************/

#include "hw_lib.h"

/*******************************************************************************
* 函数名称       : sound_senddata
* 描述           : 语音发送数据
* 输入           : 无
* 返回值         : 无
*******************************************************************************/
void sound_senddata(u8 buf[], u16 len)
{
	u16 i;
	for(i = 0;i < len;i++)
	{
		USART_SendData(UART4, (u16)(buf[i]));
		while (!(UART4->SR & USART_FLAG_TXE));
	}
}
/*******************************************************************************
* 函数名称       : sound_getdata
* 描述           : 语音接收数据
* 输入           : 无
* 返回值         : 无
*******************************************************************************/
u16 sound_getdata(u8 buf[])
{
	u16 i = 0;
	u8 sum = 0;
	u8 temp_data = 0;
	u8 len = 0;
	
	while(1)
	{
		while (!(UART4->SR & USART_FLAG_RXNE));
		temp_data = (u8)(USART_ReceiveData(UART4));	
		if(i == 0)
		{
			if(temp_data == 0xAA)
			{
				buf[i++] = 0xAA;
				sum = 0xAA;
			}
		}
		else
		{
			buf[i++] = temp_data;			
			if(i == 3) len = temp_data;
			if((len != 0) && (i == (len + 4)))
			{
				if(sum == temp_data)
				{
					return (len + 4);
				}
				else
				{
					return 0;
				}
			}
			sum += temp_data;
		}
	}	
}

/*******************************************END OF FILE******************************************/





